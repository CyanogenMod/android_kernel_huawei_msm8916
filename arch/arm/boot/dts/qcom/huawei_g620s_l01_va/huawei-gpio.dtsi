/* Copyright (c) 2013, The Linux Foundation. All rights reserved.
 *
 * This program is free software; you can redistribute it and/or modify
 * it under the terms of the GNU General Public License version 2 and
 * only version 2 as published by the Free Software Foundation.
 *
 * This program is distributed in the hope that it will be useful,
 * but WITHOUT ANY WARRANTY; without even the implied warranty of
 * MERCHANTABILITY or FITNESS FOR A PARTICULAR PURPOSE.  See the
 * GNU General Public License for more details.
 */

&soc {
nc_gpio {
    compatible = "qcom,sleep_gpio";
    ngpio = <26>;
    gpio = <0 1 2 74 77 78 79 82 83 84 87 88 89 92 94 95 101 102 105 106 111 112 116 117 118 119>;
    status = "okay";
    };
};
