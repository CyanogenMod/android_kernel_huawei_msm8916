maxim,qrd-4v35-2000mAh-lg-scud-data {
	maxim,batt-id-kohm = <110>;
	maxim,battery-type = "HB474284RBC_LG_SCUD";

	maxim,ini_rcompseg = <0x80>;
	maxim,ini_rcomp = <97>;
	maxim,ini_tempco_up = <(-100)>;		// -0.1 * 1000
	maxim,ini_tempco_dwon = <7475>;		// 7.475 * 1000
	maxim,ini_soccheck_a = <226>;
	maxim,ini_soccheck_b = <228>;
	maxim,ini_ocvtest = <57952>;
	maxim,ini_bits = <19>;
	maxim,model_data = <0xA9 0xD0 0xB7 0x20 0xB8 0x90 0xBA 0xB0>,
			<0xBB 0xD0 0xBC 0xE0 0xBE 0x00 0xBF 0x00>,
			<0xC0 0x40 0xC2 0x30 0xC4 0xA0 0xC6 0x60>,
			<0xCA 0x00 0xCD 0x70 0xD2 0x20 0xD8 0x60>,
			<0x02 0x80 0x26 0x60 0x1B 0xB0 0x27 0xE0>,
			<0x3C 0x80 0x3B 0xF0 0x2B 0xC0 0x24 0xD0>,
			<0x10 0xE0 0x16 0xD0 0x14 0x30 0x11 0x80>,
			<0x10 0x10 0x0F 0xB0 0x0B 0x00 0x0B 0x00>; 

	maxim,temperature_contrl {
		maxim,warm-bat-decidegc = <420>;
		maxim,warm-bat-uv = <4100000>;
		maxim,ibatmax-warm-ua = <800000>;
		maxim,cool-bat-decidegc = <100>;
		maxim,cool-bat-uv = <4350000>;
		maxim,ibatmax-cool-ua = <900000>;
		maxim,hot-bat-decidegc = <520>;
		maxim,cold-bat-decidegc = <0>;
	};
};
