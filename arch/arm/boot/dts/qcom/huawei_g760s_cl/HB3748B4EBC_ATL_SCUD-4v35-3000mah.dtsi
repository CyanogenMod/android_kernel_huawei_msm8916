maxim,qrd-4v35-3000mAh-atl-scud-data {
	maxim,batt-id-kohm = <10>;
	maxim,battery-type = "HB3748B4EBC_ATL_SCUD";
	maxim,full_capacity = <3000000>;

	maxim,ini_rcompseg = <0x0100>;
	maxim,ini_rcomp = <55>;
	maxim,ini_tempco_up = <(-3000)>;	// -0.3 * 10000
	maxim,ini_tempco_dwon = <(-44250)>;	// -4.425 * 10000
	maxim,ini_soccheck_a = <228>;
	maxim,ini_soccheck_b = <230>;
	maxim,ini_ocvtest = <57568>;
	maxim,ini_bits = <19>;
	maxim,model_data = <0xA9 0xF0 0xB6 0x70 0xB8 0xC0 0xBA 0xC0>,
			<0xBB 0x70 0xBB 0xC0 0xBC 0x40 0xBD 0x30>,
			<0xBE 0xA0 0xC0 0x20 0xC0 0xC0 0xC3 0xA0>,
			<0xC6 0x60 0xCC 0x10 0xD1 0xE0 0xD6 0xE0>,
			<0x02 0x60 0x1C 0x80 0x18 0x00 0x2C 0x00>,
			<0x6E 0xE0 0x2A 0xE0 0x51 0xE0 0x23 0xE0>,
			<0x25 0x20 0x2F 0xE0 0x0F 0xE0 0x16 0x80>,
			<0x11 0xA0 0x0E 0xE0 0x0C 0x00 0x0C 0x00>; 

	maxim,temperature_contrl {
		maxim,warm-bat-decidegc = <420>;
		maxim,warm-bat-uv = <4100000>;
		maxim,ibatmax-warm-ua = <800000>;
		maxim,cool-bat-decidegc = <100>;
		maxim,cool-bat-uv = <4350000>;
		maxim,ibatmax-cool-ua = <900000>;
		maxim,hot-bat-decidegc = <520>;
		maxim,cold-bat-decidegc = <0>;
	};
};
