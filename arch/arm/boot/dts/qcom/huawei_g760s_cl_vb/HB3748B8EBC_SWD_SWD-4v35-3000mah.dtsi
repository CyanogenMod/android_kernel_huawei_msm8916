maxim,qrd-4v35-3000mAh-swd-swd-data {
	maxim,batt-id-kohm = <110>;
	maxim,battery-type = "HB3748B8EBC_SWD_SWD";
	maxim,full_capacity = <3000000>;

	maxim,ini_rcompseg = <0x0100>;
	maxim,ini_rcomp = <59>;
	maxim,ini_tempco_up = <(-6750)>;	// -0.675 * 10000
	maxim,ini_tempco_down = <(-72375)>;	// -7.2375 * 10000
	maxim,ini_soccheck_a = <228>;
	maxim,ini_soccheck_b = <230>;
	maxim,ini_ocvtest = <57744>;
	maxim,ini_bits = <19>;
	maxim,model_data = <0xAA 0x30 0xB7 0x40 0xB7 0x90 0xB8 0x90>,
			<0xB9 0xA0 0xBB 0x80 0xBC 0x60 0xBD 0x00>,
			<0xBD 0xF0 0xBF 0x10 0xC0 0x60 0xC3 0x70>,
			<0xC6 0x90 0xCC 0xD0 0xD1 0xB0 0xD7 0x90>,
			<0x02 0x00 0x46 0xA0 0x26 0x60 0x22 0x00>,
			<0x14 0x40 0x52 0x00 0x2F 0x00 0x47 0x60>,
			<0x1F 0xE0 0x27 0xC0 0x15 0xC0 0x13 0xE0>,
			<0x10 0xC0 0x10 0x00 0x0C 0x00 0x0C 0x00>; 
		
	maxim,temperature_contrl {
		maxim,warm-bat-decidegc = <420>;
		maxim,warm-bat-uv = <4100000>;
		maxim,ibatmax-warm-ua = <800000>;
		maxim,cool-bat-decidegc = <100>;
		maxim,cool-bat-uv = <4350000>;
		maxim,ibatmax-cool-ua = <900000>;
		maxim,hot-bat-decidegc = <520>;
		maxim,cold-bat-decidegc = <0>;
	};
};
