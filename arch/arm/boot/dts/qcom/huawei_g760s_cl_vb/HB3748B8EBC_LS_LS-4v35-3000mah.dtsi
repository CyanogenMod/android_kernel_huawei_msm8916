maxim,qrd-4v35-3000mAh-ls-ls-data {
	maxim,batt-id-kohm = <39>;
	maxim,battery-type = "HB3748B8EBC_LS_LS";
	maxim,full_capacity = <3000000>;

	maxim,ini_rcompseg = <0x0100>;
	maxim,ini_rcomp = <59>;
	maxim,ini_tempco_up = <(-6875)>;	// -0.6875 * 10000
	maxim,ini_tempco_dwon = <(-71125)>;	// -7.1125 * 10000
	maxim,ini_soccheck_a = <234>;
	maxim,ini_soccheck_b = <236>;
	maxim,ini_ocvtest = <57520>;
	maxim,ini_bits = <19>;
	maxim,model_data = <0xA9 0xF0 0xB7 0x90 0xB8 0x00 0xB9 0xC0>,
			<0xBB 0xA0 0xBC 0x20 0xBC 0x70 0xBD 0x00>,
			<0xBE 0xC0 0xBF 0xF0 0xC0 0xF0 0xC5 0xD0>,
			<0xC9 0x30 0xCC 0x30 0xD1 0x30 0xD6 0xB0>,
			<0x02 0x20 0x67 0x80 0x1E 0x20 0x1A 0x60>,
			<0x4C 0x20 0x4C 0xC0 0x4D 0x00 0x29 0x00>,
			<0x27 0xE0 0x25 0xE0 0x13 0x80 0x10 0x20>,
			<0x12 0x60 0x10 0x00 0x0E 0x00 0x0E 0x00>; 

	maxim,temperature_contrl {
		maxim,warm-bat-decidegc = <420>;
		maxim,warm-bat-uv = <4100000>;
		maxim,ibatmax-warm-ua = <800000>;
		maxim,cool-bat-decidegc = <100>;
		maxim,cool-bat-uv = <4350000>;
		maxim,ibatmax-cool-ua = <900000>;
		maxim,hot-bat-decidegc = <520>;
		maxim,cold-bat-decidegc = <0>;
	};
};
