 / {
        huawei_fac_info {
                  compatible = "huawei,hw_fac_info";
                  fac,product_name = "HUAWEI C199s";
                  fac,hardware_ver = "HL2G760SCLM";
                  fac,software_ver = "MSM8939_C199s_VB";
                  status = "ok";
        };
};
