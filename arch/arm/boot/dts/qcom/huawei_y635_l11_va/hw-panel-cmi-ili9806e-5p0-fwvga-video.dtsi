/* Copyright (c) 2013, The Linux Foundation. All rights reserved.
 *
 * This program is free software; you can redistribute it and/or modify
 * it under the terms of the GNU General Public License version 2 and
 * only version 2 as published by the Free Software Foundation.
 *
 * This program is distributed in the hope that it will be useful,
 * but WITHOUT ANY WARRANTY; without even the implied warranty of
 * MERCHANTABILITY or FITNESS FOR A PARTICULAR PURPOSE.  See the
 * GNU General Public License for more details.
 */

/*---------------------------------------------------------------------------
 * This file is autogenerated file using gcdb parser. Please do not edit it.
 * Update input XML file to add a new entry or update variable in this file
 * VERSION = "1.0"
 *---------------------------------------------------------------------------*/
&mdss_mdp {
	dsi_cmi_ili9806e_5p0_fwvga_video: qcom,mdss_dsi_cmi_ili9806e_5p0_fwvga_video {
		qcom,mdss-dsi-panel-name = "CMI_ILI9806E_5P0_FWVGA_VIDEO";
		qcom,cont-splash-enabled;
		qcom,mdss-dsi-panel-controller = <&mdss_dsi0>;
		qcom,mdss-dsi-panel-type = "dsi_video_mode";
		qcom,mdss-dsi-panel-destination = "display_1";
		qcom,mdss-dsi-panel-clockrate = <432000000>;
		qcom,mdss-dsi-panel-framerate = <60>;
		qcom,mdss-dsi-virtual-channel-id = <0>;
		qcom,mdss-dsi-stream = <0>;
		qcom,mdss-dsi-panel-width = <480>;
		qcom,mdss-dsi-panel-height = <854>;
		qcom,mdss-dsi-h-front-porch = <92>;
		qcom,mdss-dsi-h-back-porch = <88>;
		qcom,mdss-dsi-h-pulse-width = <12>;
		qcom,mdss-dsi-h-sync-skew = <0>;
		qcom,mdss-dsi-v-back-porch = <18>;
		qcom,mdss-dsi-v-front-porch = <18>;
		qcom,mdss-dsi-v-pulse-width = <4>;
		qcom,mdss-dsi-h-left-border = <0>;
		qcom,mdss-dsi-h-right-border = <0>;
		qcom,mdss-dsi-v-top-border = <0>;
		qcom,mdss-dsi-v-bottom-border = <0>;
		qcom,mdss-dsi-bpp = <24>;
		qcom,mdss-dsi-underflow-color = <0xff>;
		qcom,mdss-dsi-border-color = <0>;
		qcom,mdss-dsi-color-order = "rgb_swap_rgb";
		qcom,mdss-dsi-pixel-packing = "tight";
		qcom,mdss-dsi-on-command = [29 01 00 00 00 00 06 FF FF 98 06 04 01
			29 01 00 00 00 00 02 08 10
			29 01 00 00 00 00 02 21 01
			29 01 00 00 00 00 02 30 01
			29 01 00 00 00 00 02 31 00
			29 01 00 00 00 00 02 40 18
			29 01 00 00 00 00 02 41 77
			29 01 00 00 00 00 02 42 02
			29 01 00 00 00 00 02 43 89
			29 01 00 00 00 00 02 44 09
			29 01 00 00 00 00 02 50 90
			29 01 00 00 00 00 02 51 90
			29 01 00 00 00 00 02 57 53
			29 01 00 00 00 00 02 60 07
			29 01 00 00 00 00 02 61 00
			29 01 00 00 00 00 02 62 07
			29 01 00 00 00 00 02 63 00
			29 01 00 00 00 00 02 A0 02
			29 01 00 00 00 00 02 A1 0D
			29 01 00 00 00 00 02 A2 16
			29 01 00 00 00 00 02 A3 0C
			29 01 00 00 00 00 02 A4 05
			29 01 00 00 00 00 02 A5 0A
			29 01 00 00 00 00 02 A6 06
			29 01 00 00 00 00 02 A7 05
			29 01 00 00 00 00 02 A8 06
			29 01 00 00 00 00 02 A9 0A
			29 01 00 00 00 00 02 AA 0F
			29 01 00 00 00 00 02 AB 09
			29 01 00 00 00 00 02 AC 0F
			29 01 00 00 00 00 02 AD 1D
			29 01 00 00 00 00 02 AE 17
			29 01 00 00 00 00 02 AF 0F
			29 01 00 00 00 00 02 C0 01
			29 01 00 00 00 00 02 C1 0D
			29 01 00 00 00 00 02 C2 16
			29 01 00 00 00 00 02 C3 0C
			29 01 00 00 00 00 02 C4 05
			29 01 00 00 00 00 02 C5 0A
			29 01 00 00 00 00 02 C6 06
			29 01 00 00 00 00 02 C7 05
			29 01 00 00 00 00 02 C8 06
			29 01 00 00 00 00 02 C9 0A
			29 01 00 00 00 00 02 CA 10
			29 01 00 00 00 00 02 CB 09
			29 01 00 00 00 00 02 CC 0F
			29 01 00 00 00 00 02 CD 1E
			29 01 00 00 00 00 02 CE 17
			29 01 00 00 00 00 02 CF 0F
			29 01 00 00 00 00 06 FF FF 98 06 04 06
			29 01 00 00 00 00 02 00 23
			29 01 00 00 00 00 02 01 0A
			29 01 00 00 00 00 02 02 00
			29 01 00 00 00 00 02 03 04
			29 01 00 00 00 00 02 04 01
			29 01 00 00 00 00 02 05 01
			29 01 00 00 00 00 02 06 80
			29 01 00 00 00 00 02 07 08
			29 01 00 00 00 00 02 08 09
			29 01 00 00 00 00 02 09 00
			29 01 00 00 00 00 02 0A 00
			29 01 00 00 00 00 02 0B 00
			29 01 00 00 00 00 02 0C 01
			29 01 00 00 00 00 02 0D 01
			29 01 00 00 00 00 02 0E 00
			29 01 00 00 00 00 02 0F 00
			29 01 00 00 00 00 02 10 7E
			29 01 00 00 00 00 02 11 F3
			29 01 00 00 00 00 02 12 04
			29 01 00 00 00 00 02 13 00
			29 01 00 00 00 00 02 14 00
			29 01 00 00 00 00 02 15 C0
			29 01 00 00 00 00 02 16 08
			29 01 00 00 00 00 02 17 00
			29 01 00 00 00 00 02 18 00
			29 01 00 00 00 00 02 19 00
			29 01 00 00 00 00 02 1A 00
			29 01 00 00 00 00 02 1B 00
			29 01 00 00 00 00 02 1C 00
			29 01 00 00 00 00 02 1D 00
			29 01 00 00 00 00 02 20 01
			29 01 00 00 00 00 02 21 23
			29 01 00 00 00 00 02 22 45
			29 01 00 00 00 00 02 23 67
			29 01 00 00 00 00 02 24 01
			29 01 00 00 00 00 02 25 23
			29 01 00 00 00 00 02 26 45
			29 01 00 00 00 00 02 27 67
			29 01 00 00 00 00 02 30 01
			29 01 00 00 00 00 02 31 86
			29 01 00 00 00 00 02 32 AA
			29 01 00 00 00 00 02 33 DB
			29 01 00 00 00 00 02 34 CC
			29 01 00 00 00 00 02 35 BD
			29 01 00 00 00 00 02 36 EE
			29 01 00 00 00 00 02 37 FF
			29 01 00 00 00 00 02 38 22
			29 01 00 00 00 00 02 39 22
			29 01 00 00 00 00 02 3A 99
			29 01 00 00 00 00 02 3B 68
			29 01 00 00 00 00 02 3C 22
			29 01 00 00 00 00 02 3D 22
			29 01 00 00 00 00 02 3E 22
			29 01 00 00 00 00 02 3F 22
			29 01 00 00 00 00 02 40 22
			29 01 00 00 00 00 02 54 13
			29 01 00 00 00 00 06 FF FF 98 06 04 07
			29 01 00 00 00 00 02 18 1D
			29 01 00 00 00 00 02 02 77
			29 01 00 00 00 00 02 E1 79
			29 01 00 00 00 00 02 06 13
			29 01 00 00 00 00 02 B3 10
			29 01 00 00 00 00 02 90 C4
			29 01 00 00 00 00 02 68 01
			29 01 00 00 00 00 06 FF FF 98 06 04 05
			29 01 00 00 00 00 02 00 02
			29 01 00 00 00 00 02 08 0B
			29 01 00 00 00 00 02 04 01
			29 01 00 00 00 00 06 FF FF 98 06 04 00
			29 01 00 00 00 00 02 36 03
			15 01 00 00 00 00 02 51 00
			15 01 00 00 00 00 02 53 24
			15 01 00 00 00 00 02 55 01
			15 01 00 00 00 00 02 5E 28
			05 01 00 00 78 00 02 11 00
			05 01 00 00 14 00 02 29 00];
		qcom,mdss-dsi-off-command = [05 01 00 00 14 00 02 28 00
					05 01 00 00 78 00 02 10 00];
		qcom,mdss-dsi-on-command-state = "dsi_lp_mode";
		qcom,mdss-dsi-off-command-state = "dsi_hs_mode";
		qcom,mdss-dsi-h-sync-pulse = <1>;
		qcom,mdss-dsi-traffic-mode = "burst_mode";
		qcom,mdss-dsi-lane-map = "lane_map_3012";
		qcom,mdss-dsi-bllp-eof-power-mode;
		qcom,mdss-dsi-bllp-power-mode;
		qcom,mdss-dsi-lane-0-state;
		qcom,mdss-dsi-lane-1-state;
		qcom,mdss-dsi-panel-timings = [7a 1a 12 00 40 42 16 1e 14 03 04 00];
		qcom,mdss-dsi-t-clk-post = <0x04>;
		qcom,mdss-dsi-t-clk-pre = <0x1d>;
		qcom,mdss-dsi-bl-min-level = <9>;
		qcom,mdss-dsi-bl-max-level = <250>;
		qcom,mdss-dsi-dma-trigger = "trigger_sw";
		qcom,mdss-dsi-mdp-trigger = "none";
		qcom,mdss-dsi-bl-pmic-control-type = "bl_ctrl_dcs";
		qcom,panel-inverse-off-cmds = [05 01 00 00 00 00 02 20 00];
		qcom,panel-inverse-on-cmds = [05 01 00 00 00 00 02 21 00];
		qcom,inverse-on-cmds-dsi-state = "dsi_lp_mode";
		qcom,inverse-off-cmds-dsi-state = "dsi_lp_mode";
		qcom,panel-cabc-ui-cmds = [15 01 00 00 00 00 02 55 01
					15 01 00 00 00 00 02 53 24];
		qcom,panel-cabc-video-cmds = [15 01 00 00 00 00 02 55 03
					15 01 00 00 00 00 02 53 2C];
		qcom,cabc-ui-cmds-dsi-state = "dsi_lp_mode";
		qcom,cabc-video-cmds-dsi-state = "dsi_lp_mode";
		qcom,panel-dot-inversion-mode-cmds = [29 01 00 00 00 00 06 FF FF 98 06 04 01
				29 01 00 00 00 00 02 31 02
				29 01 00 00 00 00 06 FF FF 98 06 04 00];
		qcom,panel-column-inversion-mode-cmds = [29 01 00 00 00 00 06 FF FF 98 06 04 01
				29 01 00 00 00 00 02 31 00
				29 01 00 00 00 00 06 FF FF 98 06 04 00];
		qcom,dot-inversion-cmds-dsi-state = "dsi_lp_mode";
		qcom,column-inversion-cmds-dsi-state = "dsi_lp_mode";
		qcom,mdss-dsi-lp11-init;
		qcom,mdss-pan-physical-width-dimension = <62>;
		qcom,mdss-pan-physical-height-dimension = <110>;
		huawei,long-read-flag = <1>;
		huawei,reg-read-expect-value = <0x9C>;
		huawei,reg-long-read-count = <3>;
			qcom,mdss-dsi-reset-sequence = <1 1>, <0 20>, <1 120>;

	};
};
