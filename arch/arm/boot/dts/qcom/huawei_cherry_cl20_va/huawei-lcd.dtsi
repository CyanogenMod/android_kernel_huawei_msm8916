/*---------------------------------------------------------------------------
 * This file is autogenerated file using huawei LCD parser. Please do not edit it.
 * Update input XML file to add a new entry or update variable in this file
 * Parser location: device/qcom/common/display/tools/huawei_lcd_panel 
 *---------------------------------------------------------------------------*/


#include "hw-panel-boe-nt35521-5p5-720p-video.dtsi"
#include "hw-panel-cmi-nt35521-5p5-720pxa-video.dtsi"
#include "hw-panel-cmi-otm1284a-5p5-720p-video.dtsi"
#include "hw-panel-tianma-nt35521-5p5-720pxa-video.dtsi"
#include "hw-panel-tianma-r61318-5p5-720p-video.dtsi"
#include "hw-panel-yassy-hx8394d01-5p5-720p-video.dtsi"
#include "hw-panel-yassy-ili98813-5p5-720p-video.dtsi"
