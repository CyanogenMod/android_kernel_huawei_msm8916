/*---------------------------------------------------------------------------
 * This file is autogenerated file using huawei LCD parser. Please do not edit it.
 * Update input XML file to add a new entry or update variable in this file
 * Parser location: device/qcom/common/display/tools/huawei_lcd_panel 
 *---------------------------------------------------------------------------*/


#include "hw-panel-boe-otm8019a-5p0-fwvga-video.dtsi"
#include "hw-panel-cmi-ili9806e-5p0-fwvga-video.dtsi"
#include "hw-panel-tianma-otm8019a-5p0-fwvga-video.dtsi"
