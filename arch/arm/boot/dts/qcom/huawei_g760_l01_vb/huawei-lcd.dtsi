/*---------------------------------------------------------------------------
 * This file is autogenerated file using huawei LCD parser. Please do not edit it.
 * Update input XML file to add a new entry or update variable in this file
 * Parser location: device/qcom/common/display/tools/huawei_lcd_panel 
 *---------------------------------------------------------------------------*/


#include "hw-panel-boe-nt35521-5p5-720p-video.dtsi"
#include "hw-panel-cmi-nt35521-5p5-720p-video.dtsi"
#include "hw-panel-tianma-nt35521-5p5-720p-video.dtsi"
