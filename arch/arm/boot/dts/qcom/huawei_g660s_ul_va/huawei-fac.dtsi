 / {
        huawei_fac_info {
                  compatible = "huawei,hw_fac_info";
                  fac,product_name = "HUAWEI G660S-UL00";
                  fac,hardware_ver = "HL0MSM8916MT0";
                  fac,software_ver = "MSM8916_G660S-UL00_VA";
                  status = "ok";
        };
};
