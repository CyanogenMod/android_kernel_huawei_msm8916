/*---------------------------------------------------------------------------
 * This file is autogenerated file using huawei LCD parser. Please do not edit it.
 * Update input XML file to add a new entry or update variable in this file
 * Parser location: device/qcom/common/display/tools/huawei_lcd_panel 
 *---------------------------------------------------------------------------*/


#include "hw-panel-boe-otm8018b-5p-fwvga-video.dtsi"
#include "hw-panel-cmi-otm8019a-5p-fwvga-video.dtsi"
#include "hw-panel-tianma-otm8019a-5p-fwvga-video.dtsi"
