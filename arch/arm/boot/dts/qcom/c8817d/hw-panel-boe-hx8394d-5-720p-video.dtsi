/* Copyright (c) 2013, The Linux Foundation. All rights reserved.
 *
 * This program is free software; you can redistribute it and/or modify
 * it under the terms of the GNU General Public License version 2 and
 * only version 2 as published by the Free Software Foundation.
 *
 * This program is distributed in the hope that it will be useful,
 * but WITHOUT ANY WARRANTY; without even the implied warranty of
 * MERCHANTABILITY or FITNESS FOR A PARTICULAR PURPOSE.  See the
 * GNU General Public License for more details.
 */

/*---------------------------------------------------------------------------
 * This file is autogenerated file using gcdb parser. Please do not edit it.
 * Update input XML file to add a new entry or update variable in this file
 * VERSION = "1.0"
 *---------------------------------------------------------------------------*/
&mdss_mdp {
	dsi_boe_hx8394d_5_720p_video: qcom,mdss_dsi_boe_hx8394d_5_720p_video {
		qcom,mdss-dsi-panel-name = "BOE_HX8394D_5_720P_VIDEO";
		qcom,cont-splash-enabled;
		qcom,mdss-dsi-panel-controller = <&mdss_dsi0>;
		qcom,mdss-dsi-panel-type = "dsi_video_mode";
		qcom,mdss-dsi-panel-destination = "display_1";
		qcom,mdss-dsi-panel-clockrate = <432000000>;
		qcom,mdss-dsi-panel-framerate = <60>;
		qcom,mdss-dsi-virtual-channel-id = <0>;
		qcom,mdss-dsi-stream = <0>;
		qcom,mdss-dsi-panel-width = <720>;
		qcom,mdss-dsi-panel-height = <1280>;
		qcom,mdss-dsi-h-front-porch = <88>;
		qcom,mdss-dsi-h-back-porch = <88>;
		qcom,mdss-dsi-h-pulse-width = <12>;
		qcom,mdss-dsi-h-sync-skew = <0>;
		qcom,mdss-dsi-v-back-porch = <20>;
		qcom,mdss-dsi-v-front-porch = <20>;
		qcom,mdss-dsi-v-pulse-width = <3>;
		qcom,mdss-dsi-h-left-border = <0>;
		qcom,mdss-dsi-h-right-border = <0>;
		qcom,mdss-dsi-v-top-border = <0>;
		qcom,mdss-dsi-v-bottom-border = <0>;
		qcom,mdss-dsi-bpp = <24>;
		qcom,mdss-dsi-underflow-color = <0xff>;
		qcom,mdss-dsi-border-color = <0>;
		qcom,mdss-dsi-color-order = "rgb_swap_rgb";
		qcom,mdss-dsi-on-command = [	29 01 00 00 00 00 04 B9 FF 83 94                                                                                                                                                                                                                                                       
			29 01 00 00 00 00 10 BA 33 83 ac 65 b2 89 09 40 10 ff 0f 00 08 3d 16                                                                                                                                                                               
			29 01 00 00 00 00 10 B1 6c 12 12 23 04 11 f1 80 99 9f 23 80 c0 d2 58                                                                                                                                                                               
			29 01 00 00 00 00 0c B2 00 64 0e 0d 12 23 08 08 1c 4d 00                                                                                                                                                                                                       
			29 01 00 00 00 00 02 D2 22                                                                                                                                                                                                                                                                   
			29 01 00 00 00 00 0d B4 00 ff 5c 5a 5c 5a 5c 5a 01 76 01 76                                                                                                                                                                                                 
			29 01 00 00 00 00 04 BF 41 0e 01                                                                                                                                                                                                                                                       
			29 01 00 00 00 00 23 D3 00 00 00 00 00 1B 10 32 10 00 00 00 32 13 C0 00 00 32 10 08 00 00 47 04 02 02 47 04 00 47 00 00 00 00                                                             
			29 01 00 00 00 00 2d D5 00 01 02 03 04 05 06 07 20 21 22 23 18 18 18 18 18 18 18 18 18 18 18 18 18 18 18 18 18 18 18 18 18 18 18 18 18 18 18 18 19 19 18 18 
			29 01 00 00 00 00 2d D6 07 06 05 04 03 02 01 00 23 22 21 20 18 18 18 18 18 18 18 18 18 18 18 18 18 18 18 18 18 18 18 18 18 18 18 18 18 18 18 18 18 18 19 19 
			29 01 00 00 00 00 2b E0 00 02 04 3A 3A 30 11 34 06 09 0C 16 0D 10 13 13 14 07 0E 10 1B 00 03 04 3A 3A 30 11 34 07 09 0C 16 0E 11 12 13 13 06 0F 11 1B             
			29 01 00 00 00 00 02 CC 09                                                                                                                                                                                                                                                                   
			29 01 00 00 00 00 05 C7 00 C0 40 C0                                                                                                                                                                                                                                                 
			29 01 00 00 00 00 03 C0 30 14                                                                                                                                                                                                                                                             
			29 01 00 00 00 00 02 BC 07
			29 01 00 00 00 00 08 C9 1F 00 12 1E 81 1E 00
			29 01 00 00 00 00 02 53 24
			29 01 00 00 00 00 02 51 00
			29 01 00 00 00 00 02 5E 28
			05 01 00 00 78 00 02 11 00];
		qcom,mdss-dsi-off-command = [05 01 00 00 14 00 02 28 00
			05  01  00  00  78  00  02  10  00];
		qcom,mdss-dsi-on-command-state = "dsi_lp_mode";
		qcom,mdss-dsi-off-command-state = "dsi_hs_mode";
		qcom,mdss-dsi-h-sync-pulse = <1>;
		qcom,mdss-dsi-traffic-mode = "burst_mode";
		qcom,mdss-dsi-lane-map = "lane_map_0123";
		qcom,mdss-dsi-bllp-eof-power-mode;
		qcom,mdss-dsi-bllp-power-mode;
		qcom,mdss-dsi-lane-0-state;
		qcom,mdss-dsi-lane-1-state;
		qcom,mdss-dsi-lane-2-state;
		qcom,mdss-dsi-lane-3-state;
		qcom,mdss-dsi-panel-timings = [7a 1a 12 00 40 42 16 1e 14 03 04 00];
		qcom,mdss-dsi-t-clk-post = <0x04>;
		qcom,mdss-dsi-t-clk-pre = <0x1c>;
		qcom,mdss-dsi-bl-min-level = <6>;
		qcom,mdss-dsi-bl-max-level = <250>;
		qcom,mdss-dsi-dma-trigger = "trigger_sw";
		qcom,mdss-dsi-mdp-trigger = "none";
		qcom,mdss-dsi-bl-pmic-control-type = "bl_ctrl_dcs";
		qcom,panel-inverse-off-cmds = [05 01 00 00 00 00 02 20 00];
		qcom,panel-inverse-on-cmds = [05 01 00 00 00 00 02 21 00];
		qcom,inverse-on-cmds-dsi-state = "dsi_lp_mode";
		qcom,inverse-off-cmds-dsi-state = "dsi_lp_mode";
		qcom,panel-dot-inversion-mode-cmds = [39 01 00 00 00 00 0C B2 02 64 10 07 32 1C 08 08 1C 4D 00];
		qcom,panel-column-inversion-mode-cmds = [39 01 00 00 00 00 0C B2 00 64 10 07 32 1C 08 08 1C 4D 00];
		qcom,dot-inversion-cmds-dsi-state = "dsi_lp_mode";
		qcom,column-inversion-cmds-dsi-state = "dsi_lp_mode";
		qcom,mdss-dsi-lp11-init;
		qcom,mdss-pan-physical-width-dimension = <62>;
		qcom,mdss-pan-physical-height-dimension = <110>;
		huawei,long-read-flag = <1>;
		huawei,reg-read-expect-value = <0x1C>;
		huawei,reg-long-read-count = <3>;
			qcom,mdss-dsi-reset-sequence = <1 1>, <0 20>, <1 120>;
		cm,mdss-livedisplay-cabc-cmd = [
			29 01 00 00 00 00 02 55 00];
		cm,mdss-livedisplay-cabc-ui-value = <0x01>;
		cm,mdss-livedisplay-cabc-image-value = <0x02>;
		cm,mdss-livedisplay-cabc-video-value = <0x03>;
		cm,mdss-livedisplay-command-state = "dsi_lp_mode";
		cm,mdss-livedisplay-post-cmd = [
			05 01 00 00 16 00 02 29 00];
	};
};
