/* Copyright (c) 2013, The Linux Foundation. All rights reserved.
 *
 * This program is free software; you can redistribute it and/or modify
 * it under the terms of the GNU General Public License version 2 and
 * only version 2 as published by the Free Software Foundation.
 *
 * This program is distributed in the hope that it will be useful,
 * but WITHOUT ANY WARRANTY; without even the implied warranty of
 * MERCHANTABILITY or FITNESS FOR A PARTICULAR PURPOSE.  See the
 * GNU General Public License for more details.
 */

qcom,qrd-4v35-2000mAh-swd-data {
	qcom,fcc-mah = <2000>;
	qcom,default-rbatt-mohm = <164>;
	qcom,rbatt-capacitive-mohm = <50>;
	qcom,flat-ocv-threshold-uv = <3800000>;
	qcom,max-voltage-uv = <4350000>;
	qcom,v-cutoff-uv = <3400000>;
	qcom,chg-term-ua = <100000>;
	qcom,batt-id-kohm = <10>;
	qcom,battery-type = "HB3742A0EBC_ATL_SWD";

	qcom,warm-bat-decidegc = <420>;
	qcom,warm-bat-mv = <4100>;
	qcom,ibatmax-warm-ma = <700>;

	qcom,cool-bat-decidegc = <100>;
	qcom,cool-bat-mv = <4350>;
	qcom,ibatmax-cool-ma = <600>;

	qcom,hot-bat-decidegc = <520>;
	qcom,cold-bat-decidegc = <0>;
	qcom,rbatt-sf-lut {
		qcom,lut-col-legend = <(-20) 0 25 40 60>;
		qcom,lut-row-legend = <100 95 90 85 80>,
				<75 70 65 60 55>,
				<50 45 40 35 30>,
				<25 20 16 13 11>,
				<10 9 8 7 6>,
				<5 4 3 2 1>,
				<0>;
		qcom,lut-data = <1557 374 100 75 65>,
				<1451 375 100 75 67>,
				<1453 375 103 76 67>,
				<1385 368 106 78 68>,
				<1338 357 111 81 69>,
				<1307 349 117 84 72>,
				<1296 338 125 89 75>,
				<1291 333 128 96 80>,
				<1320 331 106 86 76>,
				<1391 331 99 75 67>,
				<1487 331 98 76 67>,
				<1617 332 100 78 68>,
				<1785 332 103 81 71>,
				<2003 340 106 83 74>,
				<2289 357 106 82 71>,
				<2662 383 104 78 68>,
				<3182 428 105 76 67>,
				<3748 471 106 77 67>,
				<4303 523 103 76 65>,
				<4739 551 103 76 67>,
				<4917 551 101 76 67>,
				<5028 528 104 78 67>,
				<5404 550 107 79 70>,
				<5858 573 112 82 71>,
				<6390 603 118 85 72>,
				<7045 639 122 86 72>,
				<7851 679 121 82 70>,
				<8850 739 118 82 70>,
				<10192 840 123 84 72>,
				<12198 1049 134 92 77>,
				<17648 6070 1643 1572 96>;
	};

	qcom,fcc-temp-lut {
		qcom,lut-col-legend = <(-20) 0 25 40 60>;
		qcom,lut-data = <1983 1983 2001 2001 1992>;
	};

	qcom,pc-temp-ocv-lut {
		qcom,lut-col-legend = <(-20) 0 25 40 60>;
		qcom,lut-row-legend = <100 95 90 85 80>,
				<75 70 65 60 55>,
				<50 45 40 35 30>,
				<25 20 16 13 11>,
				<10 9 8 7 6>,
				<5 4 3 2 1>,
				<0>;
		qcom,lut-data = <4330 4313 4316 4317 4305>,
				<4226 4243 4256 4256 4249>,
				<4149 4183 4201 4201 4195>,
				<4082 4125 4147 4147 4142>,
				<4017 4069 4096 4096 4091>,
				<3956 4014 4048 4048 4043>,
				<3909 3964 4003 4004 4000>,
				<3868 3922 3959 3963 3959>,
				<3835 3885 3905 3910 3909>,
				<3813 3854 3867 3868 3867>,
				<3797 3825 3839 3840 3839>,
				<3783 3801 3816 3817 3817>,
				<3768 3780 3797 3798 3797>,
				<3753 3765 3781 3781 3781>,
				<3735 3752 3766 3764 3759>,
				<3716 3737 3751 3745 3734>,
				<3692 3722 3732 3726 3714>,
				<3669 3705 3710 3703 3691>,
				<3648 3693 3688 3681 3669>,
				<3632 3684 3680 3674 3663>,
				<3623 3679 3678 3672 3661>,
				<3615 3673 3676 3671 3659>,
				<3604 3668 3674 3669 3658>,
				<3591 3660 3671 3666 3655>,
				<3575 3650 3667 3662 3650>,
				<3556 3635 3656 3651 3638>,
				<3533 3610 3629 3622 3607>,
				<3502 3570 3583 3575 3562>,
				<3460 3512 3520 3512 3501>,
				<3398 3428 3434 3429 3421>,
				<3300 3300 3300 3300 3300>;
	};
};
