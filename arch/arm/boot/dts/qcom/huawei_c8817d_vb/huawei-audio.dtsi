/ {
    huawei_audio_info {
        compatible = "huawei,hw_audio_info";
        product-identifier = "c8817d";
        builtin-master-mic-exist;
        hand_held_master_mic_strategy;
        status = "ok";
        aud_param_ver = "c8817d_audio_C02";
        loud_speaker_master_mic_strategy;
        product-btsco-nrec-adapt;
    };
};
