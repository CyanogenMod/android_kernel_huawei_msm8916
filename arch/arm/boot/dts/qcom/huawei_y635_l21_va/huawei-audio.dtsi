/ {
    huawei_audio_info {
        compatible = "huawei,hw_audio_info";
        product-identifier = "y630";
        builtin-master-mic-exist;
        hand_held_master_mic_strategy;
        status = "ok";
        aud_param_ver = "y630_audio_B01";
        loud_speaker_master_mic_strategy;
        product-btsco-nrec-adapt;
    };
};
