/* Copyright (c) 2013, The Linux Foundation. All rights reserved.
 *
 * This program is free software; you can redistribute it and/or modify
 * it under the terms of the GNU General Public License version 2 and
 * only version 2 as published by the Free Software Foundation.
 *
 * This program is distributed in the hope that it will be useful,
 * but WITHOUT ANY WARRANTY; without even the implied warranty of
 * MERCHANTABILITY or FITNESS FOR A PARTICULAR PURPOSE.  See the
 * GNU General Public License for more details.
 */

/*---------------------------------------------------------------------------
 * This file is autogenerated file using gcdb parser. Please do not edit it.
 * Update input XML file to add a new entry or update variable in this file
 * VERSION = "1.0"
 *---------------------------------------------------------------------------*/
&mdss_mdp {
	dsi_tianma_nt35521_5p5_720pxa_video: qcom,mdss_dsi_tianma_nt35521_5p5_720pxa_video {
		qcom,mdss-dsi-panel-name = "TIANMA_NT35521_5P5_720P_VIDEO";
		qcom,cont-splash-enabled;
		qcom,mdss-dsi-panel-controller = <&mdss_dsi0>;
		qcom,mdss-dsi-panel-type = "dsi_video_mode";
		qcom,mdss-dsi-panel-destination = "display_1";
		qcom,mdss-dsi-panel-clockrate = <432000000>;
		qcom,mdss-dsi-panel-framerate = <60>;
		qcom,mdss-dsi-virtual-channel-id = <0>;
		qcom,mdss-dsi-stream = <0>;
		qcom,mdss-dsi-panel-width = <720>;
		qcom,mdss-dsi-panel-height = <1280>;
		qcom,mdss-dsi-h-front-porch = <88>;
		qcom,mdss-dsi-h-back-porch = <88>;
		qcom,mdss-dsi-h-pulse-width = <12>;
		qcom,mdss-dsi-h-sync-skew = <0>;
		qcom,mdss-dsi-v-back-porch = <20>;
		qcom,mdss-dsi-v-front-porch = <20>;
		qcom,mdss-dsi-v-pulse-width = <3>;
		qcom,mdss-dsi-h-left-border = <0>;
		qcom,mdss-dsi-h-right-border = <0>;
		qcom,mdss-dsi-v-top-border = <0>;
		qcom,mdss-dsi-v-bottom-border = <0>;
		qcom,mdss-dsi-bpp = <24>;
		qcom,mdss-dsi-underflow-color = <0x00>;
		qcom,mdss-dsi-border-color = <0>;
		qcom,mdss-dsi-color-order = "rgb_swap_rgb";
		qcom,mdss-dsi-on-command = [29 01 00 00 00 00 05 FF AA 55 A5 80
					29 01 00 00 00 00 03 6F 11 00
					29 01 00 00 00 00 03 F7 20 00
					29 01 00 00 00 00 02 6F 11
					29 01 00 00 00 00 02 F3 01
					29 01 00 00 00 00 06 F0 55 AA 52 08 00
					29 01 00 00 00 00 02 B1 60
					29 01 00 00 00 00 06 BD 01 A0 0C 08 01
					29 01 00 00 00 00 02 6F 02
					29 01 00 00 00 00 02 B8 01
					29 01 00 00 00 00 03 BB 11 11
					29 01 00 00 00 00 03 BC 00 00
					29 01 00 00 00 00 02 B6 06
					29 01 00 00 00 00 06 F0 55 AA 52 08 01
					29 01 00 00 00 00 03 B0 09 09
					29 01 00 00 00 00 03 B1 09 09
					29 01 00 00 00 00 03 B3 28 28
					29 01 00 00 00 00 03 B4 0F 0F
					29 01 00 00 00 00 03 B5 03 03
					29 01 00 00 00 00 03 B9 34 34
					29 01 00 00 00 00 03 BA 15 15
					29 01 00 00 00 00 03 BC 58 00
					29 01 00 00 00 00 03 BD 58 00
					29 01 00 00 00 00 02 C0 04
					29 01 00 00 00 00 02 CA 00
					29 01 00 00 00 00 06 F0 55 AA 52 08 02
					29 01 00 00 00 00 02 EE 01
					29 01 00 00 00 00 11 B0 00 00 00 3C 00 6C 00 8A 00 A4 00 CA 00 E8 01 17
					29 01 00 00 00 00 11 B1 01 3C 01 76 01 A5 01 ED 02 29 02 2A 02 65 02 A7
					29 01 00 00 00 00 11 B2 02 CF 03 05 03 29 03 58 03 78 03 A1 03 BA 03 D7
					29 01 00 00 00 00 05 B3 03 FA 03 FF
					29 01 00 00 00 00 02 6F 02
					29 01 00 00 00 00 02 F7 47
					29 01 00 00 00 00 02 6F 0A
					29 01 00 00 00 00 02 F7 02
					29 01 00 00 00 00 02 6F 17
					29 01 00 00 00 00 02 F4 70
					29 01 00 00 00 00 02 6F 11
					29 01 00 00 00 00 02 F3 01
					29 01 00 00 00 00 06 F0 55 AA 52 08 03
					29 01 00 00 00 00 03 B0 20 00
					29 01 00 00 00 00 03 B1 20 00
					29 01 00 00 00 00 06 B2 05 00 00 00 90
					29 01 00 00 00 00 06 B3 05 00 00 00 90
					29 01 00 00 00 00 06 B4 05 00 00 00 90
					29 01 00 00 00 00 06 B5 05 00 00 00 90
					29 01 00 00 00 00 06 B6 05 00 00 00 90
					29 01 00 00 00 00 06 B7 05 00 00 00 90
					29 01 00 00 00 00 06 B8 05 00 00 00 90
					29 01 00 00 00 00 06 B9 05 00 00 00 90
					29 01 00 00 00 00 06 BA 53 01 00 01 00
					29 01 00 00 00 00 06 BB 53 01 00 01 00
					29 01 00 00 00 00 06 BC 53 01 00 01 00
					29 01 00 00 00 00 06 BD 53 01 00 01 00
					29 01 00 00 00 00 02 C4 60
					29 01 00 00 00 00 02 C5 40
					29 01 00 00 00 00 02 C6 60
					29 01 00 00 00 00 02 C7 40
					29 01 00 00 00 00 02 6F 01
					29 01 00 00 00 00 02 F9 46
					29 01 00 00 00 00 06 F0 55 AA 52 08 05
					29 01 00 00 00 00 02 ED 30
					29 01 00 00 00 00 02 E5 00
					29 01 00 00 00 00 03 B0 17 06
					29 01 00 00 00 00 02 B8 00
					29 01 00 00 00 00 06 BD 03 03 01 00 03
					29 01 00 00 00 00 03 B1 17 06
					29 01 00 00 00 00 03 B9 00 03
					29 01 00 00 00 00 03 B2 17 06
					29 01 00 00 00 00 03 BA 00 00
					29 01 00 00 00 00 03 B3 17 06
					29 01 00 00 00 00 03 BB 00 00
					29 01 00 00 00 00 03 B4 17 06
					29 01 00 00 00 00 03 B5 17 06
					29 01 00 00 00 00 03 B6 17 06
					29 01 00 00 00 00 03 B7 17 06
					29 01 00 00 00 00 03 BC 00 03
					29 01 00 00 00 00 02 E5 06
					29 01 00 00 00 00 02 E6 06
					29 01 00 00 00 00 02 E7 06
					29 01 00 00 00 00 02 E8 06
					29 01 00 00 00 00 02 E9 06
					29 01 00 00 00 00 02 EA 06
					29 01 00 00 00 00 02 EB 06
					29 01 00 00 00 00 02 EC 06
					29 01 00 00 00 00 02 C0 0B
					29 01 00 00 00 00 02 C1 09
					29 01 00 00 00 00 02 C2 0B
					29 01 00 00 00 00 02 C3 09
					29 01 00 00 00 00 02 C4 10
					29 01 00 00 00 00 02 C5 10
					29 01 00 00 00 00 02 C6 10
					29 01 00 00 00 00 02 C7 10
					29 01 00 00 00 00 03 C8 08 20
					29 01 00 00 00 00 03 C9 04 20
					29 01 00 00 00 00 03 CA 07 00
					29 01 00 00 00 00 03 CB 03 00
					29 01 00 00 00 00 06 D1 00 05 00 07 10
					29 01 00 00 00 00 06 D2 00 05 04 07 10
					29 01 00 00 00 00 06 D3 00 00 0A 07 10
					29 01 00 00 00 00 06 D4 00 00 0A 07 10
					29 01 00 00 00 00 06 F0 55 AA 52 08 05
					29 01 00 00 00 00 08 D0 00 00 00 00 00 00 00
					29 01 00 00 00 00 0c D5 00 00 00 00 00 00 00 00 00 00 00
					29 01 00 00 00 00 0c D6 00 00 00 00 00 00 00 00 00 00 00
					29 01 00 00 00 00 0c D7 00 00 00 00 00 00 00 00 00 00 00
					29 01 00 00 00 00 06 D8 00 00 00 00 00
					29 01 00 00 00 00 06 F0 55 AA 52 08 06
					29 01 00 00 00 00 03 B0 12 10
					29 01 00 00 00 00 03 B1 18 16
					29 01 00 00 00 00 03 B2 00 02
					29 01 00 00 00 00 03 B3 31 31
					29 01 00 00 00 00 03 B4 31 31
					29 01 00 00 00 00 03 B5 31 31
					29 01 00 00 00 00 03 B6 31 31
					29 01 00 00 00 00 03 B7 31 31
					29 01 00 00 00 00 03 B8 31 08
					29 01 00 00 00 00 03 B9 2E 2D
					29 01 00 00 00 00 03 BA 2D 2E
					29 01 00 00 00 00 03 BB 09 31
					29 01 00 00 00 00 03 BC 31 31
					29 01 00 00 00 00 03 BD 31 31
					29 01 00 00 00 00 03 BE 31 31
					29 01 00 00 00 00 03 BF 31 31
					29 01 00 00 00 00 03 C0 31 31
					29 01 00 00 00 00 03 C1 03 01
					29 01 00 00 00 00 03 C2 17 19
					29 01 00 00 00 00 03 C3 11 13
					29 01 00 00 00 00 03 E5 31 31
					29 01 00 00 00 00 03 C4 17 19
					29 01 00 00 00 00 03 C5 11 13
					29 01 00 00 00 00 03 C6 03 01
					29 01 00 00 00 00 03 C7 31 31
					29 01 00 00 00 00 03 C8 31 31
					29 01 00 00 00 00 03 C9 31 31
					29 01 00 00 00 00 03 CA 31 31
					29 01 00 00 00 00 03 CB 31 31
					29 01 00 00 00 00 03 CC 31 09
					29 01 00 00 00 00 03 CD 2D 2E
					29 01 00 00 00 00 03 CE 2E 2D
					29 01 00 00 00 00 03 CF 08 31
					29 01 00 00 00 00 03 D0 31 31
					29 01 00 00 00 00 03 D1 31 31
					29 01 00 00 00 00 03 D2 31 31
					29 01 00 00 00 00 03 D3 31 31
					29 01 00 00 00 00 03 D4 31 31
					29 01 00 00 00 00 03 D5 00 02
					29 01 00 00 00 00 03 D6 12 10
					29 01 00 00 00 00 03 D7 18 16
					29 01 00 00 00 00 06 D8 00 00 00 00 00
					29 01 00 00 00 00 06 D9 00 00 00 00 00
					29 01 00 00 00 00 02 E7 00
					29 01 00 00 00 00 06 F0 55 AA 52 08 00
					29 01 00 00 00 00 05 E6 FF FF FA FA
					29 01 00 00 00 00 0B E8 F3 E8 E0 D8 CE C4 BA B0 A6 9C
					29 01 00 00 00 00 11 CC 41 36 87 00 00 00 00 00 00 00 00 00 40 08 A5 05
					29 01 00 00 00 00 11 D1 00 01 01 02 02 03 03 03 03 03 02 02 02 01 01 00
					29 01 00 00 00 00 0D D7 00 01 02 00 00 00 00 00 00 00 00 00
					29 01 00 00 00 00 0E D8 00 00 00 00 00 00 00 00 00 00 02 01 00
					29 01 00 00 00 00 03 D9 02 09
					15 01 00 00 00 00 02 53 24
					15 01 00 00 00 00 02 51 00
					15 01 00 00 00 00 02 5E 28
					05 01 00 00 78 00 02 11 00];
		qcom,mdss-dsi-off-command = [05 01 00 00 14 00 02 28 00
					05 01 00 00 78 00 02 10 00];
		qcom,mdss-dsi-on-command-state = "dsi_lp_mode";
		qcom,mdss-dsi-off-command-state = "dsi_hs_mode";
		qcom,mdss-dsi-h-sync-pulse = <1>;
		qcom,mdss-dsi-traffic-mode = "burst_mode";
		qcom,mdss-dsi-lane-map = "lane_map_0123";
		qcom,mdss-dsi-bllp-eof-power-mode;
		qcom,mdss-dsi-bllp-power-mode;
		qcom,mdss-dsi-lane-0-state;
		qcom,mdss-dsi-lane-1-state;
		qcom,mdss-dsi-lane-2-state;
		qcom,mdss-dsi-lane-3-state;
		qcom,mdss-dsi-panel-timings = [7a 1a 12 00 40 42 16 1e 14 03 04 00];
		qcom,mdss-dsi-t-clk-post = <0x04>;
		qcom,mdss-dsi-t-clk-pre = <0x1c>;
		qcom,mdss-dsi-bl-min-level = <6>;
		qcom,mdss-dsi-bl-max-level = <250>;
		qcom,mdss-dsi-dma-trigger = "trigger_sw";
		qcom,mdss-dsi-mdp-trigger = "none";
		qcom,mdss-dsi-bl-pmic-control-type = "bl_ctrl_dcs";
		qcom,panel-inverse-off-cmds = [05 01 00 00 00 00 02 20 00];
		qcom,panel-inverse-on-cmds = [05 01 00 00 00 00 02 21 00];
		qcom,inverse-on-cmds-dsi-state = "dsi_lp_mode";
		qcom,inverse-off-cmds-dsi-state = "dsi_lp_mode";
		qcom,panel-dot-inversion-mode-cmds = [29 01 00 00 00 00 06 F0 55 AA 52 08 00
				29 01 00 00 00 00 03 BC 01 01];
		qcom,panel-column-inversion-mode-cmds = [29 01 00 00 00 00 06 F0 55 AA 52 08 00
				29 01 00 00 00 00 03 BC 00 00];
		qcom,dot-inversion-cmds-dsi-state = "dsi_lp_mode";
		qcom,column-inversion-cmds-dsi-state = "dsi_lp_mode";
		qcom,mdss-dsi-lp11-init;
		qcom,mdss-pan-physical-width-dimension = <68>;
		qcom,mdss-pan-physical-height-dimension = <121>;
			qcom,mdss-dsi-reset-sequence = <1 1>, <0 20>, <1 120>;
		cm,mdss-livedisplay-cabc-cmd = [
			15 01 00 00 00 00 02 55 80];
		cm,mdss-livedisplay-cabc-ui-value = <0x01>;
		cm,mdss-livedisplay-cabc-image-value = <0x02>;
		cm,mdss-livedisplay-cabc-video-value = <0x03>;
		cm,mdss-livedisplay-command-state = "dsi_lp_mode";
		cm,mdss-livedisplay-post-cmd = [
			05 01 00 00 14 00 02 29 00];
	};
};
