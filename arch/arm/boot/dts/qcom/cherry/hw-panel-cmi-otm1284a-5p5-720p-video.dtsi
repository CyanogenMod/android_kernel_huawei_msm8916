/* Copyright (c) 2013, The Linux Foundation. All rights reserved.
 *
 * This program is free software; you can redistribute it and/or modify
 * it under the terms of the GNU General Public License version 2 and
 * only version 2 as published by the Free Software Foundation.
 *
 * This program is distributed in the hope that it will be useful,
 * but WITHOUT ANY WARRANTY; without even the implied warranty of
 * MERCHANTABILITY or FITNESS FOR A PARTICULAR PURPOSE.  See the
 * GNU General Public License for more details.
 */

/*---------------------------------------------------------------------------
 * This file is autogenerated file using gcdb parser. Please do not edit it.
 * Update input XML file to add a new entry or update variable in this file
 * VERSION = "1.0"
 *---------------------------------------------------------------------------*/
&mdss_mdp {
	dsi_cmi_otm1284a_5p5_720p_video: qcom,mdss_dsi_cmi_otm1284a_5p5_720p_video {
		qcom,mdss-dsi-panel-name = "CMI_OTM1284A_5P5_720P_VIDEO";
		qcom,cont-splash-enabled;
		qcom,mdss-dsi-panel-controller = <&mdss_dsi0>;
		qcom,mdss-dsi-panel-type = "dsi_video_mode";
		qcom,mdss-dsi-panel-destination = "display_1";
		qcom,mdss-dsi-panel-clockrate = <432000000>;
		qcom,mdss-dsi-panel-framerate = <60>;
		qcom,mdss-dsi-virtual-channel-id = <0>;
		qcom,mdss-dsi-stream = <0>;
		qcom,mdss-dsi-panel-width = <720>;
		qcom,mdss-dsi-panel-height = <1280>;
		qcom,mdss-dsi-h-front-porch = <88>;
		qcom,mdss-dsi-h-back-porch = <88>;
		qcom,mdss-dsi-h-pulse-width = <12>;
		qcom,mdss-dsi-h-sync-skew = <0>;
		qcom,mdss-dsi-v-back-porch = <20>;
		qcom,mdss-dsi-v-front-porch = <20>;
		qcom,mdss-dsi-v-pulse-width = <3>;
		qcom,mdss-dsi-h-left-border = <0>;
		qcom,mdss-dsi-h-right-border = <0>;
		qcom,mdss-dsi-v-top-border = <0>;
		qcom,mdss-dsi-v-bottom-border = <0>;
		qcom,mdss-dsi-bpp = <24>;
		qcom,mdss-dsi-underflow-color = <0x00>;
		qcom,mdss-dsi-border-color = <0>;
		qcom,mdss-dsi-color-order = "rgb_swap_rgb";
		qcom,mdss-dsi-on-command = [29 01 00 00 00 00 02 00 00
				29 01 00 00 00 00 04 ff 12 84 01
				29 01 00 00 00 00 02 00 80
				29 01 00 00 00 00 03 ff 12 84
				29 01 00 00 00 00 02 00 92
				29 01 00 00 00 00 03 ff 30 02
				29 01 00 00 00 00 02 00 80
				29 01 00 00 00 00 0a c0 00 64 00 10 10 00 64 10 10
				29 01 00 00 00 00 02 00 90
				29 01 00 00 00 00 07 c0 00 5c 00 01 00 04
				29 01 00 00 00 00 02 00 b3
				29 01 00 00 00 00 03 c0 00 55
				29 01 00 00 00 00 02 00 81
				29 01 00 00 00 00 02 c1 66
				29 01 00 00 00 00 02 00 a0
				29 01 00 00 00 00 0f c4 05 10 04 02 05 15 11 05 10 07 02 05 15 11
				29 01 00 00 00 00 02 00 b0
				29 01 00 00 00 00 03 c4 00 00
				29 01 00 00 00 00 02 00 91
				29 01 00 00 00 00 03 c5 a6 d2
				29 01 00 00 00 00 02 00 00
				29 01 00 00 00 00 03 d8 c7 c7
				29 01 00 00 00 00 02 00 b3
				29 01 00 00 00 00 02 c5 84
				29 01 00 00 00 00 02 00 bb
				29 01 00 00 00 00 02 c5 8a
				29 01 00 00 00 00 02 00 82
				29 01 00 00 00 00 02 c4 0a
				29 01 00 00 00 00 02 00 c6
				29 01 00 00 00 00 02 b0 03
				29 01 00 00 00 00 02 00 c2
				29 01 00 00 00 00 02 f5 40
				29 01 00 00 00 00 02 00 c3
				29 01 00 00 00 00 02 f5 85
				29 01 00 00 00 00 02 00 00
				29 01 00 00 00 00 02 d0 40
				29 01 00 00 00 00 02 00 00
				29 01 00 00 00 00 03 d1 00 00
				29 01 00 00 00 00 02 00 b2
				29 01 00 00 00 00 03 f5 00 00
				29 01 00 00 00 00 02 00 b6
				29 01 00 00 00 00 03 f5 00 00
				29 01 00 00 00 00 02 00 94
				29 01 00 00 00 00 03 f5 00 00
				29 01 00 00 00 00 02 00 d2
				29 01 00 00 00 00 03 f5 06 15
				29 01 00 00 00 00 02 00 b4
				29 01 00 00 00 00 02 c5 cc
				29 01 00 00 00 00 02 00 90
				29 01 00 00 00 00 05 f5 02 11 02 15
				29 01 00 00 00 00 02 00 90
				29 01 00 00 00 00 02 c5 50
				29 01 00 00 00 00 02 00 94
				29 01 00 00 00 00 02 c5 66
				29 01 00 00 00 00 02 00 80
				29 01 00 00 00 00 0c cb 00 00 00 00 00 00 00 00 00 00 00
				29 01 00 00 00 00 02 00 90
				29 01 00 00 00 00 10 cb 00 00 00 00 00 00 00 00 00 00 00 00 00 00 00
				29 01 00 00 00 00 02 00 a0
				29 01 00 00 00 00 10 cb 00 00 00 00 00 00 00 00 00 00 00 00 00 00 00
				29 01 00 00 00 00 02 00 b0
				29 01 00 00 00 00 10 cb 00 00 00 00 00 00 00 00 00 00 00 00 00 00 00
				29 01 00 00 00 00 02 00 c0
				29 01 00 00 00 00 10 cb 05 05 05 05 05 05 05 05 05 00 05 00 00 00 00
				29 01 00 00 00 00 02 00 d0
				29 01 00 00 00 00 10 cb 00 00 00 00 05 00 00 05 05 05 05 05 05 05 05
				29 01 00 00 00 00 02 00 e0
				29 01 00 00 00 00 0f cb 05 00 05 00 00 00 00 00 00 00 00 05 00 00
				29 01 00 00 00 00 02 00 f0
				29 01 00 00 00 00 0c cb ff ff ff ff ff ff ff ff ff ff ff
				29 01 00 00 00 00 02 00 80
				29 01 00 00 00 00 10 cc 29 2a 0a 0c 0e 10 12 14 06 00 08 00 00 00 00
				29 01 00 00 00 00 02 00 90
				29 01 00 00 00 00 10 cc 00 00 00 00 02 00 00 29 2a 09 0b 0d 0f 11 13
				29 01 00 00 00 00 02 00 a0
				29 01 00 00 00 00 0f cc 05 00 07 00 00 00 00 00 00 00 00 01 00 00
				29 01 00 00 00 00 02 00 b0
				29 01 00 00 00 00 10 cc 29 2a 13 11 0f 0d 0b 09 01 00 07 00 00 00 00
				29 01 00 00 00 00 02 00 c0
				29 01 00 00 00 00 10 cc 00 00 00 00 05 00 00 29 2a 14 12 10 0e 0c 0a
				29 01 00 00 00 00 02 00 d0
				29 01 00 00 00 00 0f cc 02 00 08 00 00 00 00 00 00 00 00 06 00 00
				29 01 00 00 00 00 02 00 80
				29 01 00 00 00 00 0d ce 89 05 10 88 05 10 00 00 00 00 00 00
				29 01 00 00 00 00 02 00 90
				29 01 00 00 00 00 0f ce 54 fc 10 54 fd 10 55 00 10 55 01 10 00 00
				29 01 00 00 00 00 02 00 a0
				29 01 00 00 00 00 0f ce 58 07 04 fc 00 10 00 58 06 04 fd 00 10 00
				29 01 00 00 00 00 02 00 b0
				29 01 00 00 00 00 0f ce 58 05 04 fe 00 10 00 58 04 04 ff 00 10 00
				29 01 00 00 00 00 02 00 c0
				29 01 00 00 00 00 0f ce 58 03 05 00 00 10 00 58 02 05 01 00 10 00
				29 01 00 00 00 00 02 00 d0
				29 01 00 00 00 00 0f ce 58 01 05 02 00 10 00 58 00 05 03 00 10 00
				29 01 00 00 00 00 02 00 80
				29 01 00 00 00 00 0f cf 50 00 05 04 00 10 00 50 01 05 05 00 10 00
				29 01 00 00 00 00 02 00 90
				29 01 00 00 00 00 0f cf 50 02 05 06 00 10 00 50 03 05 07 00 10 00
				29 01 00 00 00 00 02 00 a0
				29 01 00 00 00 00 0f cf 00 00 00 00 00 00 00 00 00 00 00 00 00 00
				29 01 00 00 00 00 02 00 b0
				29 01 00 00 00 00 0f cf 00 00 00 00 00 00 00 00 00 00 00 00 00 00
				29 01 00 00 00 00 02 00 c0
				29 01 00 00 00 00 0c cf 39 39 20 20 00 00 01 01 20 00 00
				29 01 00 00 00 00 02 00 b5
				29 01 00 00 00 00 07 c5 0b 95 ff 0b 95 ff
				29 01 00 00 00 00 02 00 b1
				29 01 00 00 00 00 02 C6 01
				29 01 00 00 00 00 02 00 b4
				29 01 00 00 00 00 02 C6 10
				29 01 00 00 00 00 02 00 00
				29 01 00 00 00 00 15 E1 08 2A 39 46 55 61 62 89 79 91 75 61 76 52 4B 3F 2F 18 06 02
				29 01 00 00 00 00 02 00 00
				29 01 00 00 00 00 15 E2 08 2A 39 46 55 61 62 89 79 91 75 61 76 52 4B 3F 2F 18 06 02
				29 01 00 00 00 00 02 00 00
				29 01 00 00 00 00 22 EC 40 43 44 34 44 44 44 44 44 44 44 44 44 34 44 44 43 44 34 44 44 43 44 34 44 44 43 44 34 44 44 43 44
				29 01 00 00 00 00 02 00 00
				29 01 00 00 00 00 22 ED 40 44 44 44 44 44 44 44 44 44 44 44 44 44 44 44 44 44 44 44 44 44 44 44 44 44 44 44 44 44 44 44 44
				29 01 00 00 00 00 02 00 00
				29 01 00 00 00 00 22 EE 40 44 44 44 44 34 44 43 44 44 44 44 44 44 44 44 43 44 44 44 44 44 44 44 44 44 44 44 44 43 44 44 44
				29 01 00 00 00 00 02 00 90
				29 01 00 00 00 00 02 D6 60
				29 01 00 00 00 00 02 00 A0
				29 01 00 00 00 00 0D D6 01 00 01 00 01 7f 01 fd 01 fd 01 fd
				29 01 00 00 00 00 02 00 B0
				29 01 00 00 00 00 0D D6 01 fd 01 fd 01 fd 01 fd 01 fd 01 fd
				29 01 00 00 00 00 02 00 C0
				29 01 00 00 00 00 0D D6 54 11 00 a9 11 a9 a9 11 a9 a9 11 a9
				29 01 00 00 00 00 02 00 D0
				29 01 00 00 00 00 07 D6 a9 11 a9 a9 11 a9
				29 01 00 00 00 00 02 00 E0
				29 01 00 00 00 00 0D D6 54 11 54 54 11 54 54 11 54 54 11 54
				29 01 00 00 00 00 02 00 F0
				29 01 00 00 00 00 07 D6 54 11 54 54 11 54
				29 01 00 00 00 00 02 00 80
				29 01 00 00 00 00 02 D6 08
				29 01 00 00 00 00 02 00 00
				29 01 00 00 00 00 03 80 00 00
				29 01 00 00 00 00 02 00 90
				29 01 00 00 00 00 02 D6 00
				29 01 00 00 00 00 02 00 00
				29 01 00 00 00 00 04 ff ff ff ff
				15 01 00 00 00 00 02 51 00
				15 01 00 00 00 00 02 53 24
				15 01 00 00 00 00 02 5E 28
				29 01 00 00 00 00 02 00 00
				29 01 00 00 00 00 02 81 80
				05 01 00 00 78 00 02 11 00];
		qcom,mdss-dsi-off-command = [05 01 00 00 14 00 02 28 00
					05 01 00 00 78 00 02 10 00];
		qcom,mdss-dsi-on-command-state = "dsi_lp_mode";
		qcom,mdss-dsi-off-command-state = "dsi_hs_mode";
		qcom,mdss-dsi-h-sync-pulse = <1>;
		qcom,mdss-dsi-traffic-mode = "burst_mode";
		qcom,mdss-dsi-lane-map = "lane_map_0123";
		qcom,mdss-dsi-bllp-eof-power-mode;
		qcom,mdss-dsi-bllp-power-mode;
		qcom,mdss-dsi-lane-0-state;
		qcom,mdss-dsi-lane-1-state;
		qcom,mdss-dsi-lane-2-state;
		qcom,mdss-dsi-lane-3-state;
		qcom,mdss-dsi-panel-timings = [7a 1E 12 00 40 42 16 22 14 03 04 00];
		qcom,mdss-dsi-t-clk-post = <0x04>;
		qcom,mdss-dsi-t-clk-pre = <0x1c>;
		qcom,mdss-dsi-bl-min-level = <6>;
		qcom,mdss-dsi-bl-max-level = <250>;
		qcom,mdss-dsi-dma-trigger = "trigger_sw";
		qcom,mdss-dsi-mdp-trigger = "none";
		qcom,mdss-dsi-bl-pmic-control-type = "bl_ctrl_dcs";
		qcom,panel-inverse-off-cmds = [05 01 00 00 00 00 02 20 00];
		qcom,panel-inverse-on-cmds = [05 01 00 00 00 00 02 21 00];
		qcom,inverse-on-cmds-dsi-state = "dsi_lp_mode";
		qcom,inverse-off-cmds-dsi-state = "dsi_lp_mode";
		qcom,panel-dot-inversion-mode-cmds = [29 01 00 00 00 00 02 00 00
			      29 01 00 00 00 00 04 FF 12 83 01
			      29 01 00 00 00 00 02 00 80
			      29 01 00 00 00 00 03 FF 12 83
			      29 01 00 00 00 00 02 00 B4
			      29 01 00 00 00 00 02 C0 00
			      29 01 00 00 00 00 02 00 00
			      29 01 00 00 00 00 04 FF FF FF FF];
		qcom,panel-column-inversion-mode-cmds = [29 01 00 00 00 00 02 00 00
			      29 01 00 00 00 00 04 FF 12 83 01
			      29 01 00 00 00 00 02 00 80
			      29 01 00 00 00 00 03 FF 12 83
			      29 01 00 00 00 00 02 00 B4
			      29 01 00 00 00 00 02 C0 50
			      29 01 00 00 00 00 02 00 00
			      29 01 00 00 00 00 04 FF FF FF FF];
		qcom,dot-inversion-cmds-dsi-state = "dsi_lp_mode";
		qcom,column-inversion-cmds-dsi-state = "dsi_lp_mode";
		qcom,mdss-dsi-lp11-init;
		qcom,mdss-pan-physical-width-dimension = <68>;
		qcom,mdss-pan-physical-height-dimension = <121>;
			qcom,mdss-dsi-reset-sequence = <1 1>, <0 20>, <1 120>;
		cm,mdss-livedisplay-cabc-cmd = [
			15 01 00 00 00 00 02 55 00];
		cm,mdss-livedisplay-cabc-ui-value = <0x01>;
		cm,mdss-livedisplay-cabc-image-value = <0x02>;
		cm,mdss-livedisplay-cabc-video-value = <0x03>;
		cm,mdss-livedisplay-command-state = "dsi_lp_mode";
		cm,mdss-livedisplay-post-cmd = [
			05 01 00 00 14 00 02 29 00];
	};
};
