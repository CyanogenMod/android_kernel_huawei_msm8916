/ {
    huawei_audio_info {
        compatible = "huawei,hw_audio_info";
        product-identifier = "g621_tl";
        builtin-master-mic-exist;
        builtin-2nd-mic-exist;
        hand_held_dual_mic_strategy;
        status = "ok";
        aud_param_ver = "g620s_ul_audio_C02";
        loud_speaker_master_mic_strategy;
        product-btsco-nrec-adapt;
    };
};
