/* Copyright (c) 2013, The Linux Foundation. All rights reserved.
 *
 * This program is free software; you can redistribute it and/or modify
 * it under the terms of the GNU General Public License version 2 and
 * only version 2 as published by the Free Software Foundation.
 *
 * This program is distributed in the hope that it will be useful,
 * but WITHOUT ANY WARRANTY; without even the implied warranty of
 * MERCHANTABILITY or FITNESS FOR A PARTICULAR PURPOSE.  See the
 * GNU General Public License for more details.
 */

/*---------------------------------------------------------------------------
 * This file is autogenerated file using gcdb parser. Please do not edit it.
 * Update input XML file to add a new entry or update variable in this file
 * VERSION = "1.0"
 *---------------------------------------------------------------------------*/
//add BOE nt35512 LCD for Y550
&mdss_mdp {
	dsi_boe_nt35512_4p5_fwvga_video: qcom,mdss_dsi_boe_nt35512_4p5_fwvga_video {
		qcom,mdss-dsi-panel-name = "BOE_NT35512_FWVGA_VIDEO";
		qcom,mdss-dsi-panel-controller = <&mdss_dsi0>;
		qcom,mdss-dsi-panel-type = "dsi_video_mode";
		qcom,mdss-dsi-panel-destination = "display_1";
		qcom,mdss-dsi-panel-framerate = <60>;
		qcom,mdss-dsi-virtual-channel-id = <0>;
		qcom,mdss-dsi-stream = <0>;
		qcom,mdss-dsi-panel-width = <480>;
		qcom,mdss-dsi-panel-height = <854>;
		qcom,mdss-dsi-h-front-porch = <108>;
		qcom,mdss-dsi-h-back-porch = <108>;
		qcom,mdss-dsi-h-pulse-width = <12>;
		qcom,mdss-dsi-h-sync-skew = <0>;
		qcom,mdss-dsi-v-back-porch = <16>;
		qcom,mdss-dsi-v-front-porch = <16>;
		qcom,mdss-dsi-v-pulse-width = <4>;
		qcom,mdss-dsi-h-left-border = <0>;
		qcom,mdss-dsi-h-right-border = <0>;
		qcom,mdss-dsi-v-top-border = <0>;
		qcom,mdss-dsi-v-bottom-border = <0>;
		qcom,mdss-dsi-bpp = <24>;
		qcom,mdss-dsi-color-order = "rgb_swap_rgb";
		qcom,mdss-dsi-underflow-color = <0xff>;
		qcom,mdss-dsi-border-color = <0>;
		qcom,mdss-dsi-on-command = [29 01 00 00 00 00 06 F0 55 AA 52 08 01
			29 01 00 00 00 00 04 B6 34 34 34
			29 01 00 00 00 00 04 B0 0F 0F 0F
			29 01 00 00 00 00 04 B7 34 34 34
			29 01 00 00 00 00 04 B1 0F 0F 0F
			29 01 00 00 00 00 04 B8 34 34 34
			29 01 00 00 00 00 04 B2 01 01 01
			29 01 00 00 00 00 04 B9 26 24 24
			29 01 00 00 00 00 04 B3 04 04 04
			29 01 00 00 00 00 04 BA 26 24 24
			29 01 00 00 00 00 04 B5 09 09 09
			29 01 00 00 00 00 04 BC 00 62 00
			29 01 00 00 00 00 04 BD 00 62 00
			29 01 00 00 00 00 02 BF 01
			29 01 00 00 00 00 35 D1 00 01 00 11 00 2B 00 40 00 52 00 70 00 8C 00 B8 00 DD 01 1A 01 4C 01 9B 01 DE 01 E0 02 1B 02 59 02 80 02 B6 02 DA 03 2B 03 5A 03 77 03 8C 03 9B 03 9F 03 FE
			29 01 00 00 00 00 35 D2 00 01 00 11 00 2B 00 40 00 52 00 70 00 8C 00 B8 00 DD 01 1A 01 4C 01 9B 01 DE 01 E0 02 1B 02 59 02 80 02 B6 02 DA 03 2B 03 5A 03 77 03 8C 03 9B 03 9F 03 FE
			29 01 00 00 00 00 35 D3 00 01 00 11 00 2B 00 40 00 52 00 70 00 8C 00 B8 00 DD 01 1A 01 4C 01 9B 01 DE 01 E0 02 1B 02 59 02 80 02 B6 02 DA 03 2B 03 5A 03 77 03 8C 03 9B 03 9F 03 FE
			29 01 00 00 00 00 35 D4 00 01 00 11 00 2B 00 40 00 52 00 70 00 8C 00 B8 00 DD 01 1A 01 4C 01 9B 01 DE 01 E0 02 1B 02 59 02 80 02 B6 02 DA 03 2B 03 5A 03 77 03 8C 03 9B 03 9F 03 FE
			29 01 00 00 00 00 35 D5 00 01 00 11 00 2B 00 40 00 52 00 70 00 8C 00 B8 00 DD 01 1A 01 4C 01 9B 01 DE 01 E0 02 1B 02 59 02 80 02 B6 02 DA 03 2B 03 5A 03 77 03 8C 03 9B 03 9F 03 FE
			29 01 00 00 00 00 35 D6 00 01 00 11 00 2B 00 40 00 52 00 70 00 8C 00 B8 00 DD 01 1A 01 4C 01 9B 01 DE 01 E0 02 1B 02 59 02 80 02 B6 02 DA 03 2B 03 5A 03 77 03 8C 03 9B 03 9F 03 FE
			29 01 00 00 00 00 06 F0 55 AA 52 08 00
			29 01 00 00 00 00 03 E0 00 01
			29 01 00 00 00 00 0B E3 F0 F0 EB EB EB E5 E5 E5 DC DC
			29 01 00 00 00 00 02 B5 6B
			29 01 00 00 00 00 02 B6 03
			29 01 00 00 00 00 03 B7 00 00
			29 01 00 00 00 00 05 B8 01 07 07 07
			29 01 00 00 00 00 02 BA 01
			29 01 00 00 00 00 04 BC 00 00 00
			29 01 00 00 00 00 06 BD 01 6C 1D 1D 00
			29 01 00 00 00 00 06 BE 01 84 07 31 00
			29 01 00 00 00 00 06 BF 01 84 07 31 00
			29 01 00 00 00 00 04 CC 03 00 00
			29 01 00 00 00 00 03 B1 F8 06
			15 01 00 00 00 00 02 36 00
			15 01 00 00 00 00 02 51 7f
			15 01 00 00 00 00 02 53 24
			15 01 00 00 00 00 02 55 01
			05 01 00 00 78 00 02 11 00
			05 01 00 00 14 00 02 29 00];
		qcom,mdss-dsi-off-command = [05 01 00 00 14 00 02 28 00
					05 01 00 00 78 00 02 10 00];
		qcom,mdss-dsi-on-command-state = "dsi_lp_mode";
		qcom,mdss-dsi-off-command-state = "dsi_hs_mode";
		qcom,mdss-dsi-h-sync-pulse = <1>;
		qcom,mdss-dsi-traffic-mode = "burst_mode";
		qcom,mdss-dsi-lane-map = "lane_map_3012";
		qcom,mdss-dsi-bllp-eof-power-mode;
		qcom,mdss-dsi-bllp-power-mode;
		qcom,mdss-dsi-lane-0-state;
		qcom,mdss-dsi-lane-1-state;
		qcom,mdss-dsi-panel-timings = [7F 1C 12 00 42 42 18 20 17 03 04 00];
		qcom,mdss-dsi-t-clk-post = <0x04>;
		qcom,mdss-dsi-t-clk-pre = <0x1B>;
		qcom,mdss-dsi-bl-min-level = <1>;
		qcom,mdss-dsi-bl-max-level = <255>;
		qcom,mdss-dsi-dma-trigger = "trigger_sw";
		qcom,mdss-dsi-mdp-trigger = "none";
		qcom,mdss-dsi-bl-pmic-control-type = "bl_ctrl_dcs";
		qcom,mdss-dsi-reset-sequence = <1 1>, <0 20>, <1 120>;
	};
};
