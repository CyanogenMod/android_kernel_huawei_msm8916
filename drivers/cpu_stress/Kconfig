## drivers/huawei/Kconfig
```kconfig
menu "huawei linux device driver support package"
source "drivers/huawei/log_module/Kconfig"
source "drivers/huawei/store_exception/Kconfig"
endmenu
```

## drivers/huawei/log_module/Kconfig
```kconfig
menu HUAWEI_LOG_MODULE

config  HUAWEI_LOG_MODULE
        default n
	bool "huawei log module"
	help
          huawei log module control

endmenu
```

## drivers/misc/huawei_apanic/Kconfig
```kconfig
config HUAWEI_APANIC
	tristate "dump panic info"
	depends on HUAWEI_KERNEL
	default n
	help
	  Say Y here to enable huawei panic info dump
```

## drivers/platform/huawei/Kconfig
```kconfig
# Huawei configuration options

config MACH_HUAWEI
	bool "Huawei device"
	depends on ARCH_MSM
	help
	  Support for Huawei products

config MACH_HUAWEI_MSM8916
	bool "HUAWEI MSM8916"
	depends on ARCH_MSM8916
	select MACH_HUAWEI
	help
	  Support for MSM8916 Huawei variants

menu "Huawei board selection"

config MACH_C8817D
	bool "C8817D board"
	select MACH_HUAWEI_MSM8916
	help
	  Support for Huawei C8817D variant

config MACH_C8817E
	bool "C8817E board"
	select MACH_HUAWEI_MSM8916
	help
	  Support for Huawei C8817E variant

config MACH_G620S_UL00
	bool "G620S_UL00 board"
	select MACH_HUAWEI_MSM8916
	help
	  Support for Huawei G620S_UL00 variant

config MACH_G620S_L01
	bool "G620S_L01 board"
	select MACH_HUAWEI_MSM8916
	help
	  Support for Huawei G620S_L01 variant

config MACH_G621_TL00
	bool "G621_TL00 board"
	select MACH_HUAWEI_MSM8916
	help
	  Support for Huawei G621_TL00 variant

config MACH_CHE1_CL10
	bool "CHE1_CL10 board"
	select MACH_HUAWEI_MSM8916
	help
	  Support for Huawei CHE1_CL10 variant

config MACH_CHE1_CL20
	bool "CHE1_CL20 board"
	select MACH_HUAWEI_MSM8916
	help
	  Support for Huawei CHE1_CL20 variant

config MACH_CHE1_L04
	bool "CHE1_L04 board"
	select MACH_HUAWEI_MSM8916
	help
	  Support for Huawei CHE1_L04 variant

endmenu
```

## drivers/srecorder/Kconfig
```kconfig
menuconfig SRECORDER
	bool "SRecorder"
	help
		SRecorder is used to save panic log when kernel crash

if SRECORDER
config SRECORDER_LOG_BUF_LEN
	hex "Length of SRecorder's reserved memory"
	default 0x140000

config SRECORDER_LOG_HEADER_H_PHYS_ADDR
	hex "The physical address of the start-up header"
	default 0xaf600000
	
config SRECORDER_LOG_HEADER_M_PHYS_ADDR
	hex "The physical address of the temp buffer"
	default 0xaf600100
	
config SRECORDER_DUMP_LOG_TO_STORAGECARD
	bool "Dump log captured by SRecorder to storage card"
	
config DUMP_CRASH_TIME
	bool "Save crash reason and time"
	default y

config DUMP_DMESG
	bool "Save dmesg"
	default y

config DUMP_SYS_INFO
	bool "Save sys info "

config DUMP_ALLCPU_STACK
	bool "Save all cpu's stack"

config DUMP_ALLPS_INFO
	bool "Save all process' basic info"

config DUMP_CURRENT_PS_BACKTRACE
	bool "Save the current process' backtace"

config DUMP_SLAB_INFO
	bool "Save slab info"

config CPU_FREQ_DEFAULT_VALUE
	int "CPU's working frequency"
	depends on DUMP_MODEM_LOG_BY_FIQ
	default 1150000000

config POWERCOLLAPSE
	bool "Save dmesg after power collapse"

config SRECORDER_VERSION
	hex "Srecorder version"
	default 0x0002

config DEBUG_SRECORDER
	bool "Debug srecorder"

endif # SRECORDER
```
